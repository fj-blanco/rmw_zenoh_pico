## CMakeLists.txt
```
cmake_minimum_required(VERSION 3.20.0)

# Add rmw_zenoh_pico as a Zephyr extra module.
list(APPEND ZEPHYR_EXTRA_MODULES ${CMAKE_CURRENT_LIST_DIR}/../../..)

find_package(Zephyr REQUIRED HINTS $ENV{ZEPHYR_BASE})
project(rmw_zenoh_pico_z_pub)

target_sources(app PRIVATE src/main.c)

if(CONFIG_ZENOH_PICO_CLIENT_MODE)
  if(NOT DEFINED ZENOH_ROUTER_IP OR "${ZENOH_ROUTER_IP}" STREQUAL "")
    if(CONFIG_WIFI)
      message(FATAL_ERROR "ZENOH_ROUTER_IP must be provided for a Wi-Fi build")
    endif()
    set(ZENOH_ROUTER_IP "127.0.0.1")
  endif()
  target_compile_definitions(app PRIVATE ZENOH_ROUTER_IP="${ZENOH_ROUTER_IP}")
endif()

# WiFi credentials (passed via -DWIFI_SSID and -DWIFI_PASS)
if(DEFINED WIFI_SSID)
  target_compile_definitions(app PRIVATE WIFI_SSID="${WIFI_SSID}")
endif()

if(DEFINED WIFI_PASS)
  target_compile_definitions(app PRIVATE WIFI_PASS="${WIFI_PASS}")
endif()

# Use common WiFi module when CONFIG_WIFI is enabled
if(CONFIG_WIFI)
  add_subdirectory(../common ${CMAKE_CURRENT_BINARY_DIR}/common)
  target_link_libraries(app PRIVATE zephyr_common)
  # Add common include directory
  target_include_directories(app PRIVATE ../common/include)
  # Pass WiFi credentials to common module too
  if(DEFINED WIFI_SSID)
    target_compile_definitions(zephyr_common PRIVATE WIFI_SSID="${WIFI_SSID}")
  endif()
  if(DEFINED WIFI_PASS)
    target_compile_definitions(zephyr_common PRIVATE WIFI_PASS="${WIFI_PASS}")
  endif()
endif()
```

## Kconfig
```
# Zenoh-pico publisher example configuration

mainmenu "Zenoh-pico Publisher Configuration"

config ZENOH_PICO_CLIENT_MODE
	bool "Use Zenoh client mode (connect to router)"
	default n
	help
	  Enable client mode to connect to a Zenoh router at tcp/127.0.0.1:7447
	  instead of using peer mode with multicast discovery.
	  This is useful for native_sim where multicast doesn't work with
	  offloaded sockets.

source "Kconfig.zephyr"
```

## west.yml
```
manifest:
  defaults:
    remote: zephyrproject

  remotes:
    - name: zephyrproject
      url-base: https://github.com/zephyrproject-rtos
    - name: zenoh-pico
      url-base: https://github.com/eclipse-zenoh

  projects:
    - name: zephyr
      remote: zephyrproject
      repo-path: zephyr
      revision: v4.1.0
      path: zephyr
      import:
        name-allowlist:
          - cmsis
          - hal_espressif
          - mbedtls
          - picolibc
    
    - name: zenoh-pico
      remote: zenoh-pico
      repo-path: zenoh-pico
      revision: 1.4.0
      path: modules/lib/zenoh-pico

  self:
    path: .
```

## prj.conf
```kconfig
# SPDX-License-Identifier: Apache-2.0

CONFIG_NEWLIB_LIBC=y
CONFIG_POSIX_API=y
CONFIG_STATIC_INIT_GNU=y

CONFIG_LOG=y
CONFIG_LOG_DEFAULT_LEVEL=3
CONFIG_PRINTK=y
CONFIG_SERIAL=y
CONFIG_UART_CONSOLE=y

CONFIG_NETWORKING=y
CONFIG_NET_SOCKETS=y
CONFIG_NET_IPV4=y
CONFIG_NET_TCP=y
CONFIG_NET_UDP=y
CONFIG_NET_DHCPV4=y
CONFIG_NET_MGMT=y
CONFIG_NET_MGMT_EVENT=y
CONFIG_NET_L2_WIFI_MGMT=y
CONFIG_NET_L2_ETHERNET=y

CONFIG_ZENOH_PICO=y
CONFIG_ZENOH_PICO_MULTI_THREAD=y
CONFIG_ZENOH_PICO_PUBLICATION=y
CONFIG_ZENOH_PICO_LINK_TCP=y
CONFIG_ZENOH_PICO_LINK_UDP_UNICAST=y
CONFIG_ZENOH_PICO_LINK_UDP_MULTICAST=y
CONFIG_ZENOH_PICO_SCOUTING_UDP=y
CONFIG_RMW_ZENOH_PICO_SIMPLE_PUB=y

CONFIG_MAIN_STACK_SIZE=8192
CONFIG_SYSTEM_WORKQUEUE_STACK_SIZE=4096
CONFIG_HEAP_MEM_POOL_SIZE=49152
CONFIG_IDLE_STACK_SIZE=2048
CONFIG_ISR_STACK_SIZE=4096

CONFIG_SHELL=n
CONFIG_PM=n
CONFIG_SMP=n
```

## boards/esp32_devkitc_procpu.conf
```kconfig
# ESP32 board configuration (Zephyr 4.2.1)
# Keep only valid symbols for the current tree.

# WiFi core
CONFIG_WIFI=y

# Enable ESP32 Wi-Fi driver (requires blobs)
CONFIG_WIFI_ESP32=y

# Auto DHCP when STA connects
CONFIG_ESP32_WIFI_STA_AUTO_DHCPV4=y

# If you have an older silicon revision, you may need this; otherwise leave unset
CONFIG_ESP32_USE_UNSUPPORTED_REVISION=y

# Zenoh client mode - connect to router at 192.168.1.132:7447
CONFIG_ZENOH_PICO_CLIENT_MODE=y
```

## boards/esp32_devkitc_wroom_procpu.conf
```kconfig
# SPDX-License-Identifier: Apache-2.0

CONFIG_WIFI=y
CONFIG_WIFI_ESP32=y
CONFIG_ESP32_WIFI_STA_AUTO_DHCPV4=y
CONFIG_ESP32_USE_UNSUPPORTED_REVISION=y
CONFIG_FLASH_SIZE=4194304
CONFIG_FLASH_BASE_ADDRESS=0x0
CONFIG_ZENOH_PICO_CLIENT_MODE=y
```

## boards/native_sim.conf
```kconfig
# Native simulation configuration for Zenoh-pico publisher
# Uses offloaded sockets (NSOS - Native Simulator Offloaded Sockets)
# This allows the app to use the host's network stack directly via localhost

# Disable TAP interface (prevents "Cannot create zeth" error)
CONFIG_ETH_NATIVE_TAP=n

# Enable offloaded sockets for native_sim (uses host BSD sockets)
CONFIG_NET_SOCKETS_OFFLOAD=y
CONFIG_NET_NATIVE_OFFLOADED_SOCKETS=y

# Disable WiFi
CONFIG_WIFI=n

# Zenoh client mode - connect to router instead of multicast discovery
CONFIG_ZENOH_PICO_CLIENT_MODE=y
```

## boards/esp32_devkitc_procpu.overlay
```dts
/* Enable Wi-Fi peripheral on ESP32 */
&wifi {
	status = "okay";
};
```

## boards/esp32_devkitc_wroom_procpu.overlay
```dts
/* SPDX-License-Identifier: Apache-2.0 */

&wifi {
	status = "okay";
};
```

## src/main.c
```c
#include <zephyr/kernel.h>
#include <zephyr/logging/log.h>
#include <errno.h>
#include <stdio.h>
#include <string.h>

#include <rmw_zenoh_pico/zephyr_simple_pub.h>

#include <zephyr/net/net_if.h>
#include <zephyr/net/net_ip.h>
#ifdef CONFIG_WIFI
#include "wifi.h"
#include <zephyr/net/net_mgmt.h>
#endif

LOG_MODULE_REGISTER(zenoh_pub, LOG_LEVEL_INF);

#define KEYEXPR "demo/example/zenoh-pico-pub"
#define VALUE "Hello from Zephyr!"

#ifdef CONFIG_WIFI
/* IPv4 address event-based logger */
static struct net_mgmt_event_callback ipv4_cb;

static void ipv4_event_handler(struct net_mgmt_event_callback *cb, uint64_t event,
                               struct net_if *iface) {
    ARG_UNUSED(cb);
    if (event != NET_EVENT_IPV4_ADDR_ADD) {
        return;
    }
    struct in_addr *addr = net_if_ipv4_get_global_addr(iface, NET_ADDR_PREFERRED);
    if (addr && addr->s_addr != 0) {
        char ipbuf[NET_IPV4_ADDR_LEN];
        net_addr_ntop(AF_INET, addr, ipbuf, sizeof(ipbuf));
        LOG_INF("WiFi IPv4 address: %s", ipbuf);
    }
}
#endif

void main(void)
{
    LOG_INF("Zenoh-pico publisher starting on Zephyr");
    LOG_INF("Build: %s", CONFIG_BOARD);
    
#ifdef CONFIG_WIFI
    /* Initialize and connect WiFi before starting Zenoh */
    (void) wifi_init(NULL);
    if (connect_to_wifi() < 0) {
        LOG_ERR("WiFi connect request failed");
        return;
    }
    if (wait_for_wifi_connection() < 0) {
        LOG_ERR("WiFi did not connect in time");
        return;
    }

    /* Log IPv4 once DHCP completes using a net_mgmt event callback. */
    net_mgmt_init_event_callback(&ipv4_cb, ipv4_event_handler, NET_EVENT_IPV4_ADDR_ADD);
    net_mgmt_add_event_callback(&ipv4_cb);
    /* If DHCP already completed, log immediately. */
    {
        struct in_addr *addr =
            net_if_ipv4_get_global_addr(net_if_get_default(), NET_ADDR_PREFERRED);
        if (addr && addr->s_addr != 0) {
            char ipbuf[NET_IPV4_ADDR_LEN];
            net_addr_ntop(AF_INET, addr, ipbuf, sizeof(ipbuf));
            LOG_INF("WiFi IPv4 address: %s", ipbuf);
        }
    }
#else
    /* For native_sim, just log the configured IP */
    LOG_INF("Running on native_sim - network interface ready");
    struct net_if *iface = net_if_get_default();
    if (iface) {
        struct in_addr *addr = net_if_ipv4_get_global_addr(iface, NET_ADDR_PREFERRED);
        if (addr && addr->s_addr != 0) {
            char ipbuf[NET_IPV4_ADDR_LEN];
            net_addr_ntop(AF_INET, addr, ipbuf, sizeof(ipbuf));
            LOG_INF("IPv4 address: %s", ipbuf);
        }
    }
    // Give network stack time to initialize (especially for native_sim offloaded sockets)
    k_sleep(K_MSEC(100));
#endif
    
    bool client_mode = false;
#ifdef CONFIG_ZENOH_PICO_CLIENT_MODE
    client_mode = true;
#endif
    const char *connect_endpoint = NULL;
#ifdef CONFIG_ZENOH_PICO_CLIENT_MODE
    char endpoint[64];
    (void)snprintf(endpoint, sizeof(endpoint), "tcp/%s:7447", ZENOH_ROUTER_IP);
    connect_endpoint = endpoint;
#endif

    int rc = rzp_zephyr_run_publisher(KEYEXPR, VALUE, client_mode, connect_endpoint);
    if (rc < 0) {
        LOG_ERR("rmw_zenoh_pico publisher failed: %d", rc);
        return;
    }
#ifdef CONFIG_WIFI
    wifi_disconnect();
#endif
}
```
