## CMakeLists.txt
```
cmake_minimum_required(VERSION 3.20.0)

# The manifest places micro-ROS in the repository's West workspace.
set(MICROROS_MODULE_DIR
    ${CMAKE_CURRENT_LIST_DIR}/../../../modules/lib/microros/modules/libmicroros
    CACHE PATH "Path to the micro-ROS Zephyr libmicroros module")
if(NOT EXISTS ${MICROROS_MODULE_DIR}/zephyr/module.yml)
  message(FATAL_ERROR "MICROROS_MODULE_DIR does not contain the libmicroros Zephyr module")
endif()

list(APPEND ZEPHYR_EXTRA_MODULES
     ${CMAKE_CURRENT_LIST_DIR}/../../..
     ${MICROROS_MODULE_DIR})

find_package(Zephyr REQUIRED HINTS $ENV{ZEPHYR_BASE})
project(rmw_zenoh_pico_talker)

target_sources(app PRIVATE src/main.c)

if(NOT DEFINED ZENOH_ROUTER_IP OR "${ZENOH_ROUTER_IP}" STREQUAL "")
  if(CONFIG_WIFI)
    message(FATAL_ERROR "ZENOH_ROUTER_IP must be provided for a Wi-Fi build")
  endif()
  set(ZENOH_ROUTER_IP "127.0.0.1")
endif()
target_compile_definitions(app PRIVATE ZENOH_ROUTER_IP="${ZENOH_ROUTER_IP}")
target_link_libraries(app PRIVATE rmw_zenoh_pico microros)

# WiFi credentials (passed via -DWIFI_SSID and -DWIFI_PASS)
if(DEFINED WIFI_SSID)
  target_compile_definitions(app PRIVATE WIFI_SSID="${WIFI_SSID}")
endif()

if(DEFINED WIFI_PASS)
  target_compile_definitions(app PRIVATE WIFI_PASS="${WIFI_PASS}")
endif()

# Use common WiFi module when CONFIG_WIFI is enabled
if(CONFIG_WIFI)
  add_subdirectory(../common ${CMAKE_CURRENT_BINARY_DIR}/common)
  target_link_libraries(app PRIVATE zephyr_common)
  # Add common include directory
  target_include_directories(app PRIVATE ../common/include)
  # Pass WiFi credentials to common module too
  if(DEFINED WIFI_SSID)
    target_compile_definitions(zephyr_common PRIVATE WIFI_SSID="${WIFI_SSID}")
  endif()
  if(DEFINED WIFI_PASS)
    target_compile_definitions(zephyr_common PRIVATE WIFI_PASS="${WIFI_PASS}")
  endif()
endif()
```

## Kconfig
```
config RMW_ZENOH_PICO_TALKER
	bool "RMW Zenoh-pico Zephyr talker application"
	default y
	help
	  RMW-based Zephyr talker using rmw_zenoh_pico middleware
	  and RCL/RCLC APIs to publish std_msgs/String messages.

source "Kconfig.zephyr"
```

## west.yml
```
manifest:
  defaults:
    remote: zephyrproject

  remotes:
    - name: zephyrproject
      url-base: https://github.com/zephyrproject-rtos
    - name: zenoh-pico
      url-base: https://github.com/eclipse-zenoh
    - name: micro-ros
      url-base: https://github.com/micro-ROS

  projects:
    - name: zephyr
      remote: zephyrproject
      repo-path: zephyr
      revision: v4.1.0
      path: zephyr
      import:
        name-allowlist:
          - cmsis
          - hal_espressif
          - mbedtls
          - picolibc
    
    - name: zenoh-pico
      remote: zenoh-pico
      repo-path: zenoh-pico
      revision: 1.4.0
      path: modules/lib/zenoh-pico

    - name: micro_ros_zephyr_module
      remote: micro-ros
      revision: jazzy
      path: modules/lib/microros

  self:
    path: .
```

## prj.conf
```kconfig
# SPDX-License-Identifier: Apache-2.0

CONFIG_NEWLIB_LIBC=y
CONFIG_POSIX_API=y
CONFIG_STATIC_INIT_GNU=y

CONFIG_LOG=y
CONFIG_LOG_DEFAULT_LEVEL=3
CONFIG_PRINTK=y
CONFIG_SERIAL=y
CONFIG_UART_CONSOLE=y

CONFIG_NETWORKING=y
CONFIG_NET_SOCKETS=y
CONFIG_NET_IPV4=y
CONFIG_NET_TCP=y
CONFIG_NET_UDP=y
CONFIG_NET_DHCPV4=y
CONFIG_NET_MGMT=y
CONFIG_NET_MGMT_EVENT=y
CONFIG_NET_L2_WIFI_MGMT=y
CONFIG_NET_L2_ETHERNET=y

CONFIG_MICROROS=y
CONFIG_MICROROS_TRANSPORT_UDP=y
CONFIG_MICROROS_NODES="1"
CONFIG_MICROROS_PUBLISHERS="1"
CONFIG_MICROROS_SUBSCRIBERS="0"
CONFIG_MICROROS_CLIENTS="0"
CONFIG_MICROROS_SERVERS="0"

CONFIG_ZENOH_PICO=y
CONFIG_ZENOH_PICO_MULTI_THREAD=y
CONFIG_ZENOH_PICO_PUBLICATION=y
CONFIG_ZENOH_PICO_SUBSCRIPTION=y
CONFIG_ZENOH_PICO_QUERY=y
CONFIG_ZENOH_PICO_QUERYABLE=y
CONFIG_ZENOH_PICO_LINK_TCP=y
CONFIG_ZENOH_PICO_LINK_UDP_UNICAST=y
CONFIG_ZENOH_PICO_LINK_UDP_MULTICAST=y
CONFIG_ZENOH_PICO_SCOUTING_UDP=y
CONFIG_RMW_ZENOH_PICO=y

CONFIG_MAIN_STACK_SIZE=8192
CONFIG_SYSTEM_WORKQUEUE_STACK_SIZE=4096
CONFIG_HEAP_MEM_POOL_SIZE=65536
CONFIG_IDLE_STACK_SIZE=2048
CONFIG_ISR_STACK_SIZE=4096

CONFIG_SHELL=n
CONFIG_PM=n
CONFIG_SMP=n
```

## boards/esp32_devkitc_procpu.conf
```kconfig
# ESP32 board configuration (Zephyr 4.2.1)
# Keep only valid symbols for the current tree.

# WiFi core
CONFIG_WIFI=y

# Enable ESP32 Wi-Fi driver (requires blobs)
CONFIG_WIFI_ESP32=y

# Auto DHCP when STA connects
CONFIG_ESP32_WIFI_STA_AUTO_DHCPV4=y

# If you have an older silicon revision, you may need this; otherwise leave unset
CONFIG_ESP32_USE_UNSUPPORTED_REVISION=y

# Note: Zenoh client mode configured via rmw_zenoh_pico or runtime config
# CONFIG_ZENOH_PICO_CLIENT_MODE=y not available in zenoh-pico Kconfig
```

## boards/esp32_devkitc_wroom_procpu.conf
```kconfig
# SPDX-License-Identifier: Apache-2.0

CONFIG_WIFI=y
CONFIG_WIFI_ESP32=y
CONFIG_ESP32_WIFI_STA_AUTO_DHCPV4=y
CONFIG_ESP32_USE_UNSUPPORTED_REVISION=y
CONFIG_FLASH_SIZE=4194304
CONFIG_FLASH_BASE_ADDRESS=0x0
```

## boards/native_sim.conf
```kconfig
# Native simulation configuration for Zenoh-pico publisher
# Uses offloaded sockets (NSOS - Native Simulator Offloaded Sockets)
# This allows the app to use the host's network stack directly via localhost

# Disable TAP interface (prevents "Cannot create zeth" error)
CONFIG_ETH_NATIVE_TAP=n

# Enable offloaded sockets for native_sim (uses host BSD sockets)
CONFIG_NET_SOCKETS_OFFLOAD=y
CONFIG_NET_NATIVE_OFFLOADED_SOCKETS=y

# Disable WiFi
CONFIG_WIFI=n
```

## src/main.c
```c
/*
 * Copyright(C) 2024 eSOL Co., Ltd.
 * SPDX-License-Identifier: Apache-2.0
 */

#include <stdio.h>
#include <string.h>

#include <zephyr/kernel.h>
#include <zephyr/logging/log.h>

#include <rcl/error_handling.h>
#include <rcl/rcl.h>
#include <rclc/executor.h>
#include <rclc/rclc.h>
#include <rmw_zenoh_pico/rmw_zenoh_pico_options.h>
#include <std_msgs/msg/string.h>

#ifdef CONFIG_WIFI
#include "wifi.h"
#endif

LOG_MODULE_REGISTER(rmw_zenoh_pico_talker, LOG_LEVEL_INF);

#define MESSAGE_CAPACITY 96

static rcl_publisher_t publisher;
static rclc_support_t support;
static rcl_node_t node;
static rcl_timer_t timer;
static rclc_executor_t executor;
static std_msgs__msg__String message;
static char message_buffer[MESSAGE_CAPACITY];
static unsigned int sequence;

static bool check_rcl(rcl_ret_t result, const char * operation)
{
  if (result == RCL_RET_OK) {
    return true;
  }

  LOG_ERR("%s failed: %d (%s)", operation, (int)result, rcl_get_error_string().str);
  rcl_reset_error();
  return false;
}

static void timer_callback(rcl_timer_t * timer_handle, int64_t last_call_time)
{
  ARG_UNUSED(last_call_time);

  if (timer_handle == NULL) {
    return;
  }

  int length = snprintf(message_buffer, sizeof(message_buffer),
    "Hello from Zephyr rmw_zenoh_pico: %u", sequence++);
  if (length < 0) {
    LOG_ERR("Message formatting failed");
    return;
  }

  message.data.size = (size_t)length;
  if (rcl_publish(&publisher, &message, NULL) == RCL_RET_OK) {
    LOG_INF("Published: %s", message_buffer);
  } else {
    LOG_ERR("Publish failed");
  }
}

int main(void)
{
  rcl_allocator_t allocator = rcl_get_default_allocator();

  LOG_INF("Starting rmw_zenoh_pico talker on %s", CONFIG_BOARD);

#ifdef CONFIG_WIFI
  wifi_init(NULL);
  if (connect_to_wifi() != 0 || wait_for_wifi_connection() != 0) {
    LOG_ERR("Wi-Fi connection failed");
    return -1;
  }
#endif

  rmw_zenoh_pico_set_mode("client");
  rmw_zenoh_pico_set_unicast(ZENOH_ROUTER_IP, "7447", NULL, NULL);

  executor = rclc_executor_get_zero_initialized_executor();
  message.data.data = message_buffer;
  message.data.size = 0;
  message.data.capacity = sizeof(message_buffer);

  if (!check_rcl(rclc_support_init(&support, 0, NULL, &allocator), "rclc_support_init") ||
    !check_rcl(rclc_node_init_default(&node, "zephyr_zenoh_talker", "", &support),
      "rclc_node_init_default") ||
    !check_rcl(rclc_publisher_init_default(
      &publisher, &node, ROSIDL_GET_MSG_TYPE_SUPPORT(std_msgs, msg, String), "chatter"),
      "rclc_publisher_init_default") ||
    !check_rcl(rclc_timer_init_default2(
      &timer, &support, RCL_MS_TO_NS(1000), timer_callback, true),
      "rclc_timer_init_default2") ||
    !check_rcl(rclc_executor_init(&executor, &support.context, 1, &allocator),
      "rclc_executor_init") ||
    !check_rcl(rclc_executor_add_timer(&executor, &timer), "rclc_executor_add_timer"))
  {
    return -1;
  }

  LOG_INF("RMW_ZENOH_PICO_READY router=tcp/%s:7447 topic=/chatter", ZENOH_ROUTER_IP);
  rclc_executor_spin(&executor);
  return 0;
}
```
